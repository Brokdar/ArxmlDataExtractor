AUTOSAR XML (schema 4-2-1)
package /Cluster
  can cluster CAN: baudrate=500000, protocol-name=CAN  # CAN Channel 1
package /PDU
  pdu TxMessage: length=5, minimum-delay=0, transmission-mode-false-timing=cyclic-timing={time-offset=0, time-period=0.1}, transmission-mode-true-timing=cyclic-timing={time-offset=0, time-period=0.1}, unused-bit-pattern=0
  pdu RxMessage: length=1, minimum-delay=0, transmission-mode-false-timing=cyclic-timing={time-offset=0, time-period=0.1}, transmission-mode-true-timing=cyclic-timing={time-offset=0, time-period=0.1}, unused-bit-pattern=0
