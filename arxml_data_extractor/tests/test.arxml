AUTOSAR XML (schema 4-2-1)
package /Cluster
  can cluster CAN: baudrate=500000, protocol-name=CAN  # CAN Channel 1
