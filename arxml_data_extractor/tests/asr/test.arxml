AUTOSAR XML (schema 4-3-0)
package /Pdus
  ar packages Bus
package /Pdus/Bus/PduCollection
  pdu MyPdu: minimum-delay=0.02, transmission-mode-true-timing=event-controlled-timing=number-of-repetitions=0
    signal SignalData1: start 0, 1 bit, little-endian, i-signal-type=PRIMITIVE, init-value=0
    signal SignalData2: start 8, 1 bit, little-endian, i-signal-type=PRIMITIVE, init-value=0
package /ISignals/Bus
  ar packages PduCollection
